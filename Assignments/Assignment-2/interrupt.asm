CPU "8085.TBL"             
HOF "INT8"

HXDSP:       EQU 034FH     ;monitor routines   
OUTPUT:      EQU 0389H 

ORG 8FBFH                  ;putting ISR into the location
JMP INTR     

ORG 9000H

MVI A,00H                  
STA 08102H                  ;address which stores the counter value
MVI A,01DH
STA 08103H                  ;address which contains the first memory location out of the 5 consecutive
MVI A,02BH
STA 08104H
MVI A,039H
STA 08105H
MVI A,047H
STA 08106H
MVI A,025H
STA 08107H
MVI A,00H
STA 08108H
MVI A,00H
STA 08109H
MVI A,00H
STA 0810AH
JMP START

START:
	MVI A,0BH
	SIM
	EI
	MVI A,0H
	JMP INF

INTR:
	LDA 8102H
	CPI 000H
	JZ SUM
	CPI 001H
	JZ CADD
	CPI 002H
	JZ AVG
	JMP INF

INF:
	INR A 
	JMP INF

AVG:
	LDA 8108H
	MVI B, 05H
	MVI C, 0H
	DIV:
		SUB B
		JC DIV_EXIT
		INR C
		JMP DIV
	DIV_EXIT:
		MOV E,C
		CALL DISPLAY
		CALL INFI
		JMP INF

SUM:
	MVI D,00H
	LXI H, 8103H
	MOV B,M
	ADD B

	LXI H, 8104H
	MOV B,M
	ADD B
	JNC ADD1
	INR D

ADD1: LXI H, 8105H
	MOV B,M
	ADD B
	JNC ADD2
	INR D

ADD2:LXI H, 8106H
	MOV B,M
	ADD B
	JNC ADD3
	
ADD3:LXI H, 8107H
	MOV B,M
	ADD B
	JNC ADD4
	INR D
ADD4:STA 8108H
	MOV E,A
	CALL DISPLAY
	CALL INFI
	JMP INF

CADD:
	MVI D,00H
	LDA 8103H
	CMA
	MOV B,A

	LDA 8104H
	CMA
	ADD B
	JNC CARR1
	INR D
CARR1:
	MOV B,A
	
	LDA 8105H
	CMA
	ADD B
	JNC CARR2
	INR D
CARR2:
	MOV B,A
	
	LDA 8106H
	CMA
	ADD B
	JNC CARR3
	INR D
CARR3:
	MOV B,A
	
	LDA 8107H
	CMA
	ADD B
	JNC CARR4
	INR D
CARR4:
	MOV B,A
	
	STA 8109H
	MOV E,A	
	CALL DISPLAY
	CALL INFI
	JMP INF
	
INFI:
	LDA 8102H
	INR A
	STA 8102H
	MVI A,1BH
	MVI B,0H
	MVI C,0H
	SIM
	EI
	RET
	
DISPLAY:      

	CALL HXDSP
	MVI A,00H
	MVI B,00H
	CALL OUTPUT
	CALL DELAY
	RET

DELAY:
	MVI D,FFFFH
	LOOP:
		DCX D
		MOV A,D
		ORA E
		JNZ LOOP
	RET